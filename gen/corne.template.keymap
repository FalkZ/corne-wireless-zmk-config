/*
 * Copyright (c) 2020 The ZMK Contributors
 *
 * SPDX-License-Identifier: MIT
 */

#include <behaviors.dtsi>
#include <dt-bindings/zmk/keys.h>

/ {
    behaviors {
        left_cmd: left_command {
            compatible = "zmk,behavior-keypress";
            label = "LEFT_COMMAND";
            #binding-cells = <0>;
            bindings = <&kp LEFT_COMMAND>;
        };

        cmd_spot: command_spotlight {
            compatible = "zmk,behavior-hold-tap";
            label = "COMMAND_SPOTLIGHT";
            bindings = <&kp>, <&spotlight>;

            #binding-cells = <2>;
            tapping-term-ms = <200>;
            flavor = "hold-preferred";
        };
      
{{behaviors}}
    };

    macros {
        spotlight: spotlight {
            compatible = "zmk,behavior-macro";
            #binding-cells = <0>;
            bindings = <&kp LG(SPACE)>;
            label = "SPOTLIGHT";
        };
    };

    keymap {
        compatible = "zmk,keymap";

        default_layer {
            label = "Base";
            bindings = <
{{base_layer}}
            >;
        };

        lower_layer {
            label = "Code";
            bindings = <
{{code_layer}}
           >;
        };
    };
};

